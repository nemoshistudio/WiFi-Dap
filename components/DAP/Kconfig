## components/DAP/Kconfig
```kconfig
menu "WiFi Dap core (CMSIS-DAP command engine)"

    config BIRDIEBOT_DAP_STATS
        bool "Enable DAP core profiling counters + Vendor9 stats command"
        default n
        help
            Debug-only instrumentation for OpenOCD/elaphureLink throughput work.

            Counts per-command processing time and the gap between consecutive
            host commands (transport round trip), the command-type histogram,
            0x7E/0x7F batch statistics, SWD transfer count and
            DAP_TransferBlock word counts.  A CMSIS-DAP Vendor9 command
            (0x89, sub-command 1 = snapshot, 0 = reset) returns the counters so
            a host-side raw-DAP client (elaphureLink port 3240) can read them
            remotely without serial console access.

            Production builds keep this disabled: no counters, no time reads,
            no Vendor9 handler.

    config BIRDIEBOT_SWD_ULTRA_FAST
        bool "ESP32-S3 dedicated-GPIO SWD engine (all SWD rates, 100 kHz-20 MHz)"
        default y
        depends on IDF_TARGET_ESP32S3
        help
            Enable the M5 Xtensa dedicated-GPIO SWD engine
            (components/DAP/cmsis-dap/source/SWD_Fast_GPIO.c) and make it the
            ONLY SWD backend on the ESP32-S3: SWD_Transfer at every adapter
            speed, SWJ_Sequence (line reset / JTAG-to-SWD / dormant wake-up)
            and SWD_Sequence (capture) all run on it.  The legacy GPIO
            normal/fast and 40 MHz SPI SWD backends are compiled out for this
            target; if the engine cannot run (wrong core, pins not routed,
            CPU < 150 MHz) the SWD entry points return DAP errors instead of
            silently falling back.

            Rate coverage: 100 kHz .. 20 MHz on the default 160 MHz CPU build,
            up to 24 MHz on a 240 MHz CPU build.  The engine picks a level
            that is never faster than the host request (the mapping keeps the
            error within 0 .. -25 %); high rates use fully unrolled assembly,
            low rates use cycle-counter paced loops.

            On hardware: 12/16 MHz were stable on an STM32H723, 20 MHz was
            marginal on that target/wiring - OpenOCD `adapter speed 16000` is
            the recommended setting there (docs/swd-23mhz-engine.md §6).

            Default is y per the M4/M5 user requests.  The engine is not yet
            validated on every target/wiring combination: set this to n to
            restore the legacy GPIO/SPI backend selection exactly, and read
            docs/swd-23mhz-engine.md for the HIL checklist and rollback.
            Only affects ESP32-S3 SWD; JTAG, ESP32, C3 and C5 are unchanged.

    config BIRDIEBOT_SWD_ULTRA_MIN_CLOCK_HZ
        int "DEPRECATED: minimum DAP_SWJ_Clock request (Hz, 0 = engine for all rates)"
        default 0
        depends on BIRDIEBOT_SWD_ULTRA_FAST
        range 0 50000000
        help
            Deprecated in M5 and kept only for build compatibility with the M4
            DAP_SWJ_Clock wiring: the engine now covers every SWD rate, so the
            default 0 means "no minimum - the engine is used for all adapter
            speeds".  It will be removed once DAP_SWJ_Clock no longer
            references it (see docs/swd-23mhz-engine.md §4).

            A non-zero value would make DAP_SWJ_Clock fall through to the
            legacy backend selection below that request; do not set it on a
            build with M5 wiring.

    config BIRDIEBOT_SWD_ULTRA_OEN_STAY_ON
        bool "Keep SWDIO output enabled during SWD turnaround (A-fork workaround)"
        default n
        depends on BIRDIEBOT_SWD_ULTRA_FAST
        help
            SWD requires the host to release SWDIO during the turnaround and
            the ACK/data phases driven by the target.  The ultra engine does
            that by default (same approach as XRDAP-ESP, including the
            GPIO_ENABLE read-back and settle delay).

            The current GPIO fast path on this board keeps the SWDIO pad
            output enabled all the time (the A 2025 fork workaround, see
            DAP_config.h PIN_SWDIO_OUT_ENABLE/DISABLE on ESP32-S3), and that
            is the configuration known to pass OpenOCD bring-up on this board.
            Enable this option to make the ultra engine use the same
            "always driven" behaviour for the HIL A/B comparison if the
            protocol-correct turnaround fails on a particular target/wiring.

            Leave it disabled unless HIL debugging says otherwise.

endmenu
```

## components/SSDP/Kconfig
```kconfig
menu "WiFi Dap SSDP (UPnP discovery)"

    config BIRDIEBOT_SSDP_ENABLE
        bool "Enable the SSDP service (UDP 1900 + /SSDP.xml description)"
        default n
        help
            Slim build (H1, 2026-10-26): the SSDP responder is disabled
            because UPnP discovery is no longer part of the product.  When
            disabled, components/SSDP/ssdp.c compiles to an empty translation
            unit, wifi_manager no longer starts the service, the WiFi
            IP-event handler no longer feeds it the station IP/gateway and
            the embedded Web UI no longer serves /SSDP.xml.

            The source and the public API stay in the tree so a full-feature
            image can be restored with one Kconfig line
            (docs/feature-flags.md H1).  mDNS (wt_mdns) is independent and
            stays enabled.
endmenu
```

## components/board/Kconfig
```kconfig
menu "WiFi Dap board configuration"

    choice BIRDIEBOT_BOARD
        prompt "Target board"
        default BIRDIEBOT_BOARD_ZXR_DAP_S3 if IDF_TARGET_ESP32S3
        default BIRDIEBOT_BOARD_GENERIC_C3 if IDF_TARGET_ESP32C3
        default BIRDIEBOT_BOARD_GENERIC_ESP32 if IDF_TARGET_ESP32
        default BIRDIEBOT_BOARD_GENERIC_C5 if IDF_TARGET_ESP32C5
        help
            Board pin map used by the CMSIS-DAP layer (components/DAP),
            the UART TCP bridge and the status LEDs.

            The pin tables are documented in docs/board-pins.md.
            Select the board that matches `idf.py set-target ...`; a
            mismatch only produces a build warning (see
            src/birdiebot_board.c), it is not a hard error so that
            compile-only target bring-up stays possible.

        config BIRDIEBOT_BOARD_ZXR_DAP_S3
            bool "BOARD_ZXR_DAP_S3 (default, WiFi Dap ESP32-S3 DAP)"
            depends on IDF_TARGET_ESP32S3
            help
                Default WiFi Dap board (8MB ESP32-S3):
                SWCLK=12 SWDIO=11 TDO=15 TDI=16 nTRST=14 nRESET=13,
                UART1 bridge TX=10 RX=9, status LEDs 5/6, WiFi LED 4.

        config BIRDIEBOT_BOARD_GENERIC_S3
            bool "BOARD_GENERIC_S3 (upstream generic ESP32-S3 wiring)"
            depends on IDF_TARGET_ESP32S3
            help
                Upstream / fork generic ESP32-S3 wiring:
                SWCLK=12 SWDIO=11 TDO=9 TDI=10 nTRST=14 nRESET=13,
                UART1 bridge TX=17 RX=18, no status LEDs.

        config BIRDIEBOT_BOARD_GENERIC_C3
            bool "BOARD_GENERIC_C3 (compile-only, ESP32-C3)"
            depends on IDF_TARGET_ESP32C3
            help
                Upstream generic ESP32-C3 wiring:
                SWCLK=6 SWDIO=7 TDO=3 TDI=5 nTRST=4 nRESET=10,
                UART1 bridge TX=21 RX=20, no status LEDs.
                Compile-only in this project (no hardware validation).

        config BIRDIEBOT_BOARD_GENERIC_ESP32
            bool "BOARD_GENERIC_ESP32 (compile-only, ESP32)"
            depends on IDF_TARGET_ESP32
            help
                Upstream generic ESP32 wiring:
                SWCLK=14 SWDIO=13 TDO=19 TDI=18 nTRST=25 nRESET=26,
                UART2 bridge TX=23 RX=22, no status LEDs.
                Compile-only in this project (no hardware validation).

        config BIRDIEBOT_BOARD_GENERIC_C5
            bool "BOARD_GENERIC_C5 (compile-only, ESP32-C5)"
            depends on IDF_TARGET_ESP32C5
            help
                Compile-only ESP32-C5 reference wiring (no C5 hardware
                validation in this branch; see docs/esp32-c5-port.md):
                SWCLK=6 SWDIO=7 (SPI2 FSPICLK/FSPID direct IO_MUX),
                TDO=8 TDI=9 nTRST=3 nRESET=10,
                UART1 bridge TX=23 RX=24, no status LEDs.
                Wi-Fi-only variant: ESP32-C5 has no USB-OTG/NCM.

    endchoice

endmenu
```

## components/dap_proxy/Kconfig
```kconfig
menu "WiFi Dap proxy (USBIP / WebSocket-DAP)"

    config BIRDIEBOT_DAP_WS_ENABLE
        bool "Enable the legacy WebSocket-DAP transport (TCP 3240)"
        default y
        help
            Accepts a WebSocket-DAP session on the DAP proxy port
            (components/dap_proxy/websocket_server.c): the client upgrades
            from HTTP with "GET ", then sends binary frames whose payload is a
            CMSIS-DAP command packet.

            This is an unauthenticated, plain-text transport: enable it only
            on a trusted LAN (docs/INTEGRATION-PLAN.md P7.1).  Disable it to
            run USBIP and elaphureLink only; the port stays open for those
            two protocols.

            Default: y (laboratory mode, same as the fork).

    config BIRDIEBOT_USBIP_PIPELINE
        bool "Enable multi-URB USBIP pipeline (B1)"
        default y
        help
            Decouples the USBIP TCP reader from the DAP command execution so
            that several URBs can be in flight per Wi-Fi round-trip (the host
            kernel vhci + OpenOCD cmsis-dap keep up to 3 pending requests).
            OUT URBs are ACKed immediately and IN URBs are answered by the DAP
            task when the matching response is ready; UNLINKs keep the
            response/IN FIFOs aligned.  The legacy single-URB path is used when
            this option is disabled or the pipeline detects an inconsistency.

            Default: y (same transport, lower latency on a real Wi-Fi link).

    config BIRDIEBOT_USBIP_TCP_CORE
        int "Core affinity of the USBIP tcp_server task"
        range 0 1
        default 1
        help
            The DAP task must run on core 1 (dedicated-GPIO SWD bit-banging).
            Keeping the USBIP tcp_server task on core 1 (default) minimizes the
            hand-off latency to the DAP task; core 0 decouples the Wi-Fi/lwIP
            handling from the DAP bit-banging CPU time.  Both placements are
            measured in the B1 hardware window.

    config BIRDIEBOT_USBIP_TCP_PRIORITY
        int "Priority of the USBIP tcp_server task"
        range 5 24
        default 14
        help
            FreeRTOS priority of the USBIP/EL/WS-DAP TCP task.  The DAP command
            task priority is BIRDIEBOT_DAP_TASK_PRIORITY (default 16); raising
            this above the DAP task lets network ACKs preempt SWD bit-banging,
            lowering the per-URB latency at some SWD throughput cost.

    config BIRDIEBOT_DAP_TASK_PRIORITY
        int "Priority of the DAP command task"
        range 5 24
        default 16

    config BIRDIEBOT_DAP_PACKET_SIZE
        int "DAP packet size reported to the debugger (bytes, ESP32-S3)"
        range 256 4048
        default 1280
        help
            CMSIS-DAP packet size returned by DAP_Info and used for the USBIP
            stage2 payload buffer.  The USBIP transport is latency-bound, so a
            larger packet means more SWD data per OUT+IN URB round-trip.

            OpenOCD 0.12 (cmsis-dap DAP_Transfer, u8 transfer count) derives its
            block size as (packet-4)/5 and is only correct up to 1280
            ((1280-4)/5 = 255 transfers).  OpenOCD master uses DAP_TransferBlock
            (u16 count) and can use a much larger packet (e.g. 4000-4048);
            this is A/B measured in the B1 hardware window and the release
            default is chosen from that data.

            Other targets are fixed at 1024 by main/dap_configuration.h.

endmenu
```

## components/dap_tcp/Kconfig
```kconfig
menu "WiFi Dap TCP backend (CMSIS-DAP over TCP)"

    config BIRDIEBOT_DAP_TCP_ENABLE
        bool "Enable the CMSIS-DAP over TCP backend (OpenOCD cmsis-dap backend tcp)"
        default n
        help
            Listen on TCP 3241 and serve one debugger at a time with the
            CMSIS-DAP TCP frame format shared by OpenOCD's cmsis-dap TCP
            backend and the XRDAP probes (8-byte header "DAP\0" + u16
            little-endian length + type + reserved, then the CMSIS-DAP
            packet).  Frame format, state machine and host tests:
            docs/dap-tcp-backend.md.

            M3 SKELETON: the server reads frames but does not run the DAP
            engine.  Every request is handed to the weak hook
            birdiebot_dap_tcp_execute(); the default implementation reports
            "not wired" and the server closes the connection.  Wire the hook
            (docs/dap-tcp-backend.md section 7) before enabling this in a
            release build.

            The transport is plain text and unauthenticated: enable it only on
            a trusted LAN.

            Default: n - the shipped USBIP / WebSocket-DAP / elaphureLink
            behaviour is unchanged and nothing listens on 3241.

    config BIRDIEBOT_DAP_TCP_PORT
        int "Listening port"
        depends on BIRDIEBOT_DAP_TCP_ENABLE
        range 1024 65535
        default 3241
        help
            TCP port of the CMSIS-DAP backend.  3241 matches the XRDAP probes;
            OpenOCD selects it with `cmsis-dap tcp port 3241`.  The port is
            free in this firmware (the removed corsacOTA service used it), and
            the USBIP / WebSocket-DAP / elaphureLink front-end keeps 3240.

    config BIRDIEBOT_DAP_TCP_CORE
        int "Core affinity of the DAP TCP server task"
        depends on BIRDIEBOT_DAP_TCP_ENABLE
        range 0 1
        default 1 if SOC_CPU_CORES_NUM > 1
        default 0
        help
            Core that runs the DAP TCP server task.  On the dual-core
            ESP32-S3, core 1 places the socket task next to the DAP task
            (BIRDIEBOT_DAP_TASK_PRIORITY) and the USBIP front-end, which
            minimizes the hand-off latency to SWD.

            Single-core targets (ESP32, ESP32-C3, ESP32-C5) must use 0: pinning
            a task to core 1 trips the FreeRTOS core-id assert.

    config BIRDIEBOT_DAP_TCP_TASK_STACK
        int "Stack size of the DAP TCP server task (bytes)"
        depends on BIRDIEBOT_DAP_TCP_ENABLE
        range 3072 8192
        default 4096
        help
            The session buffers (~2 KiB) are static, so the stack only covers
            lwIP socket calls and the frame handling.  4096 matches the USBIP
            front-end task on the S3; raise it if a stack overflow is observed.

    config BIRDIEBOT_DAP_TCP_TASK_PRIORITY
        int "Priority of the DAP TCP server task"
        depends on BIRDIEBOT_DAP_TCP_ENABLE
        range 5 24
        default 14
        help
            FreeRTOS priority of the DAP TCP server task; 14 matches the USBIP
            front-end (BIRDIEBOT_USBIP_TCP_PRIORITY).  The DAP command task
            runs higher (16), so an accepted request still gets the SWD
            bit-banging time slice promptly.

endmenu
```

## components/target_flash_debug/Kconfig
```kconfig
menu "WiFi Dap target flash debug"

    config BIRDIEBOT_TARGET_FLASH_DEBUG_HTTP
        bool "Enable /tf bring-up HTTP endpoint (lab verification only)"
        default n
        help
            Registers a minimal POST-only HTTP endpoint on the existing web
            server for hardware bring-up and lab verification without the Web
            UI:

              POST /tf/probe    probe the SWD target, return JSON info
              POST /tf/status   return the current status snapshot
              POST /tf/flash    body = raw image, program+verify+reset, return
                                JSON with expected/actual SHA-256 and timings
              POST /tf/abort    abort a running flash
              POST /tf/pc       halt, read the target PC, resume (reset check)

            Requests need the normal web Host/Origin guard (web_host_guard)
            and an extra "X-WiFi Dap-Target-Flash: 1" header.  The endpoint
            calls the same blocking engine API as the production Web flow, so
            it must only be enabled on a trusted LAN during bring-up.
            Default: n (production builds contain no endpoint code).

endmenu
```

## components/uart_tcp_bridge/Kconfig
```kconfig
menu "WiFi Dap UART TCP bridge"

    config BIRDIEBOT_UART_BRIDGE_ENABLE
        bool "Enable the UART TCP bridge (TCP 1346)"
        default y
        help
            Forwards a raw TCP connection on port 1346 to the target UART
            (115200-8N1 by default, A 2025 defaults; the old 1234/74880 values
            are deprecated) and back.  UART instance and TX/RX pins come from
            the selected board (components/board, docs/board-pins.md).

            The bridge is unauthenticated and plain-text: enable it only on a
            trusted LAN (docs/INTEGRATION-PLAN.md P7.1).

            Default: y (laboratory mode, same as the fork).

endmenu
```

## components/wired_dap/Kconfig
```kconfig
menu "WiFi Dap wired DAP (C1: USB-NCM MVP)"

    choice BIRDIEBOT_WIRED_TRANSPORT
        prompt "DAP transport"
        default BIRDIEBOT_WIRED_TRANSPORT_NONE
        help
            C1 wired-DAP MVP: move the DAP transport from Wi-Fi to a wired USB
            link while keeping the existing USBIP/OpenOCD tool-chain.
            Design/effort/risks: docs/wired-dap-plan.md and docs/wired-dap-mvp.md.

            The DEFAULT is NONE: the production Wi-Fi-only behaviour is
            unchanged and the default `build/esp32s3` (and C3/ESP32) artifacts
            are not affected.

            The wired variant is a separate build:
                scripts/build-wired.sh
            which applies sdkconfig.wired.defaults and produces
            build/esp32s3-wired/. It is not part of the default release matrix.

        config BIRDIEBOT_WIRED_TRANSPORT_NONE
            bool "Wi-Fi only (default, production behaviour)"

        config BIRDIEBOT_WIRED_TRANSPORT_NCM
            bool "USB-NCM Ethernet + existing USBIP/OpenOCD (wired MVP)"
            depends on SOC_USB_OTG_SUPPORTED
            help
                TinyUSB CDC-NCM on the ESP32-S3 native USB-OTG port plus a
                minimal esp_netif/lwIP Ethernet driver:

                  device IP (static): 192.168.7.1/24
                  DAP proxy:          existing TCP 3240 (USBIP/elaphureLink/WS-DAP)
                  host setup:         USB NCM network adapter 192.168.7.2/24
                                      + `usbip attach_ude -r 192.168.7.1 -b 1-1`
                                      + unchanged OpenOCD command line.

                Building this option requires (scripts/build-wired.sh applies
                both automatically):
                  - CONFIG_TINYUSB_NET_MODE_NCM=y (esp_tinyusb component)
                  - CONFIG_ESP_CONSOLE_SECONDARY_NONE=y
                    (USB-OTG and USB-Serial/JTAG cannot be active at the same
                     time; the wired build keeps the console on UART0)

                Flashing/recovery for a wired build: BOOT+RESET into the ROM
                USB-Serial/JTAG download mode, UART0 download, or Web UI OTA
                (Wi-Fi is kept enabled; see docs/wired-dap-mvp.md §4).
    endchoice

endmenu
```

## components/wt_ota/Kconfig
```kconfig
menu "WiFi Dap OTA module (module 5, WP-205)"

    config BIRDIEBOT_OTA_ENABLE
        bool "Enable the OTA JSON module 5 (GET_INFO / GET_PROGRESS / ABORT)"
        default n
        help
            Registers the OTA module (id 5) on the existing WS/API JSON routers
            through API_JSON_MODULE_REGISTER.

            Slim build (A2, 2026-10-26): default n because the Web OTA upload
            feature is disabled (CONFIG_BIRDIEBOT_WEB_OTA_UPLOAD_ENABLE);
            module 5 then answers nothing.  Set to y together with the upload
            endpoint to restore the full OTA feature
            (docs/feature-flags.md A2).  The OTA partition table, bootloader
            rollback configuration and the rollback helpers
            (wt_ota_mark_app_valid()) stay enabled either way: main/ still
            confirms a pending-verify image after boot.

    config BIRDIEBOT_OTA_BUF_SIZE
        int "HTTP upload receive chunk size (bytes)"
        default 4096
        range 512 16384
        help
            Static receive buffer size used by uri_ota.c (WP-206) for
            httpd_req_recv(). docs/ota-local-upload.md §3.2 requires a static
            buffer (~4096 B), never a 3 MB heap allocation.

    config BIRDIEBOT_OTA_IDLE_TIMEOUT_MS
        int "Upload idle timeout (ms)"
        default 10000
        range 1000 600000
        help
            docs/ota-local-upload.md §3.3: no body bytes for this long ->
            esp_ota_abort() + state ERROR("upload timeout") + HTTP 408.

    config BIRDIEBOT_OTA_MAX_DURATION_MS
        int "Maximum upload session duration (ms)"
        default 300000
        range 10000 3600000
        help
            docs/ota-local-upload.md §3.3: total session cap from
            esp_ota_begin(); exceeding it aborts the session the same way.

    config BIRDIEBOT_OTA_AUTO_MARK_VALID
        bool "Automatically confirm a pending-verify OTA image after boot"
        default n
        help
            When CONFIG_BOOTLOADER_APP_ROLLBACK_ENABLE=y, an OTA-updated image
            boots in ESP_OTA_IMG_PENDING_VERIFY and must be confirmed by the
            application. The preferred integration is for main/app_main to call
            wt_ota_mark_app_valid() from a single 10 s timer after WiFi, the
            webserver and the DAP/UART tasks are up (docs/ota-local-upload.md
            §2.3). Enabling this option lets the component schedule that
            confirmation itself (useful until the main/ hook lands).

    config BIRDIEBOT_OTA_AUTO_MARK_VALID_DELAY_MS
        int "Auto-confirm delay after boot (ms)"
        depends on BIRDIEBOT_OTA_AUTO_MARK_VALID
        default 10000
        range 1000 60000
        help
            Delay before the component calls wt_ota_mark_app_valid() when
            BIRDIEBOT_OTA_AUTO_MARK_VALID is enabled.

endmenu
```

## project_components/web_server/Kconfig
```kconfig
menu "WiFi Dap web server (HTTP / WebSocket)"

    # ------------------------------------------------------------------
    # Slim-build feature switches (2026-10-26).  All default n: the code is
    # kept in the tree and can be re-enabled from the full-features backup
    # (tag backup/full-features-2026-10-26, or the matching Kconfig options).
    # Per-item macro / file / restore recipe / resource cost:
    # docs/feature-flags.md.
    # ------------------------------------------------------------------

    config BIRDIEBOT_WEB_OTA_UPLOAD_ENABLE
        bool "Enable the Web OTA upload endpoint (POST /api/ota/upload)"
        default n
        help
            Slim build (A1): removes the browser OTA upload feature.  When
            disabled, uri_modules/uri_ota.c compiles to a read-only
            diagnostics stub (the frozen /api/target/status ota_upload_*
            field set stays present and reports inactive), so the URI
            handler, the upload worker task and its static 2 x 4 KiB receive
            buffers are gone.

            OTA partitions, the bootloader rollback configuration and
            wt_ota_mark_app_valid() are kept for every target so images can
            still be installed through a future/recovery path
            (docs/feature-flags.md A1/A2).

    config BIRDIEBOT_WEB_DISCOVER_ENABLE
        bool "Enable GET /api/discover (nearby DAP discovery via mDNS)"
        default n
        depends on BIRDIEBOT_TARGET_FLASH_ENABLE
        help
            Slim build (H3): removes the nearby-device discovery endpoint.
            When disabled, the /api/discover URI, its JSON row buffer and the
            blocking mDNS _http._tcp query (components/target_flash
            tf_discover.c) are compiled out; the Web keeps the manual /
            recent-device list and treats the missing endpoint as
            "no discovery".  mDNS advertising of this device (wt_mdns) is
            NOT affected.

    config BIRDIEBOT_WEB_HOST_GUARD
        bool "Enable the browser Host/Origin guard (CSWSH / DNS rebinding)"
        default n
        help
            SECURITY RELEVANT - disabled by default in the slim build by
            explicit project decision (2026-10-26, docs/feature-flags.md M1
            and docs/security.md).  The implementation stays in
            web_host_guard.c and every handler keeps its call site, so
            re-enabling is one Kconfig line.

            With the guard disabled, HTTP and WebSocket handlers accept any
            Host/Origin value:
              * a malicious web page on the same network can open
                ws://<device-ip>/ws from another origin (cross-site
                WebSocket hijacking, CSWSH) and drive the DAP/target;
              * a DNS-rebinding hostname resolves to the device and a
                browser can operate it as same-origin.
            This is only acceptable on a trusted lab/office LAN because the
            firmware has no login/auth layer at all (docs/security.md).

    config BIRDIEBOT_TARGET_FLASH_ENABLE
        bool "Enable Web target-flash endpoints (/api/target/*)"
        default y
        help
            Registers the browser-driven direct-flash HTTP endpoints:

              GET  /api/target/info     probe the SWD target, return identity
                                        (family/DPIDR/CPUID/IDCODE/UID/flash)
              POST /api/target/flash    octet-stream upload; the body is
                                        streamed over SWD and programmed into the
                                        target flash while it arrives (no
                                        staging partition)
              GET  /api/target/status   flash engine status snapshot
              POST /api/target/reset    optional {"run":true} SWD reset/run

            The flash algorithm lives in components/target_flash (CMSIS-DAP
            over the existing SWD pins).  While flashing, the flash engine owns
            the DAP exclusively: USBIP / WS-DAP / elaphureLink sessions are
            paused and restored afterwards.  The browser-side upload progress
            is driven by XHR events; other HTTP requests are only serviced
            between chunks and during the erase/verify phases.

            Intended for an internal/lab LAN only (the web login feature was
            removed by project decision; the browser Host/Origin guard can be
            enabled with CONFIG_BIRDIEBOT_WEB_HOST_GUARD).  Disable to compile
            the endpoints out.

            The separate GET /api/discover endpoint is registered together
            with these URIs and has its own switch above.

    config BIRDIEBOT_WEB_ALLOWED_ORIGIN
        string "Extra allowed Host/Origin entries (comma separated)"
        default ""
        depends on BIRDIEBOT_WEB_HOST_GUARD
        help
            Comma-separated allow-list for the browser Host/Origin check in
            web_host_guard.c (CSWSH / DNS-rebinding hardening; this is a
            browser-safety policy, not a login feature).  Only used when
            CONFIG_BIRDIEBOT_WEB_HOST_GUARD=y.  Each entry is either a full
            origin (scheme://host[:port]) or a bare hostname, e.g.
                "http://192.168.1.1:8080,https://dap.local"

            - Host header check: the request must carry a Host that is an IP
              literal, an entry from this list, or CONFIG_LWIP_LOCAL_HOSTNAME.
              This blocks DNS-rebinding hostnames (an attacker-controlled DNS
              name resolving to the device IP is rejected).
            - Origin header check: when a browser sends Origin it must be
              same-origin with the request Host, or match an entry from this
              list (blocks cross-site WebSocket hijacking, CSWSH).

            Accessing the device through its IP (the documented way,
            docs/protocol.md §1) needs no entry.  Accessing it through a
            hostname (e.g. the mDNS name "dap.local", or a reverse-proxy
            name) requires adding that name here, e.g.
                CONFIG_BIRDIEBOT_WEB_ALLOWED_ORIGIN="http://dap.local"

endmenu
```
